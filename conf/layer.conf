## conf/layer.conf
```bitbake
# We have a conf and classes directory, add to BBPATH
BBPATH .= ":${LAYERDIR}"
 
# We have a packages directory, add to BBFILES
BBFILES += "${LAYERDIR}/recipes-*/*/*.bb \
   ${LAYERDIR}/recipes-*/*/*.bbappend"

BBFILE_COLLECTIONS += "demo"
BBFILE_PATTERN_demo := "^${LAYERDIR}/"
BBFILE_PRIORITY_demo = "4"

LAYERSERIES_COMPAT_demo = "sumo"
```
